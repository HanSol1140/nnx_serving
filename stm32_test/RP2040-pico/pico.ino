UART Serial2(8, 9);

void setup() {
  Serial.begin(115200);  // USB 연결을 통한 시리얼 (디버깅 용도)
  Serial1.begin(115200); // UART0 (GP0 & GP1)
  Serial2.begin(115200); // UART1 (GP8 & GP9)
}
// ==============================================================================================================
void sendBytes(const byte* sequence, size_t size) {
  for (size_t i = 0; i < size; ++i) {
    Serial2.write(sequence[i]);
  }
}
// ==============================================================================================================
void loop() { // 아래로 갈수록 빨라짐                                이곳 값만 변함
  //                                                                  ↓     ↓           ↓     ↓     ↓
  // byte Speed[] = {0xD5, 0x5D, 0xFE, 0x0A, 0x83, 0x20, 0x02, 0x0A, 0x18, 0x80, 0x0B, 0x18, 0x00, 0x72};
  // byte Speed[] = {0xD5, 0x5D, 0xFE, 0x0A, 0x83, 0x20, 0x02, 0x0A, 0x31, 0x80, 0x0B, 0x31, 0x00, 0x31};
  // byte Speed[] = {0xD5, 0x5D, 0xFE, 0x0A, 0x83, 0x20, 0x02, 0x0A, 0x49, 0x80, 0x0B, 0x49, 0x00, 0xD4};
  // byte Speed[] = {0xD5, 0x5D, 0xFE, 0x0A, 0x83, 0x20, 0x02, 0x0A, 0x62, 0x80, 0x0B, 0x62, 0x00, 0x06};
  // byte Speed[] = {0xD5, 0x5D, 0xFE, 0x0A, 0x83, 0x20, 0x02, 0x0A, 0x7A, 0x80, 0x0B, 0x7A, 0x00, 0x36};
  // byte Speed[] = {0xD5, 0x5D, 0xFE, 0x0A, 0x83, 0x20, 0x02, 0x0A, 0x93, 0x80, 0x0B, 0x93, 0x00, 0x68};
  // byte Speed[] = {0xD5, 0x5D, 0xFE, 0x0A, 0x83, 0x20, 0x02, 0x0A, 0xAB, 0x80, 0x0B, 0xAB, 0x00, 0x98};
  // byte Speed[] = {0xD5, 0x5D, 0xFE, 0x0A, 0x83, 0x20, 0x02, 0x0A, 0xC4, 0x80, 0x0B, 0xC4, 0x00, 0xCA};
  // byte Speed[] = {0xD5, 0x5D, 0xFE, 0x0A, 0x83, 0x20, 0x02, 0x0A, 0xDC, 0x80, 0x0B, 0xDC, 0x00, 0xFA};
  // byte Speed[] = {0xD5, 0x5D, 0xFE, 0x0A, 0x83, 0x20, 0x02, 0x0A, 0xF5, 0x80, 0x0B, 0xF5, 0x00, 0x2C};
  // byte Speed[] = {0xD5, 0x5D, 0xFE, 0x0A, 0x83, 0x20, 0x02, 0x0A, 0x0E, 0x81, 0x0B, 0x0E, 0x01, 0x60};
  // byte Speed[] = {0xD5, 0x5D, 0xFE, 0x0A, 0x83, 0x20, 0x02, 0x0A, 0x26, 0x81, 0x0B, 0x26, 0x01, 0x90};
  // byte Speed[] = {0xD5, 0x5D, 0xFE, 0x0A, 0x83, 0x20, 0x02, 0x0A, 0x3F, 0x81, 0x0B, 0x3F, 0x01, 0xC2};
  // byte Speed[] = {0xD5, 0x5D, 0xFE, 0x0A, 0x83, 0x20, 0x02, 0x0A, 0x57, 0x81, 0x0B, 0x57, 0x01, 0xF2};
  // byte Speed[] = {0xD5, 0x5D, 0xFE, 0x0A, 0x83, 0x20, 0x02, 0x0A, 0x70, 0x81, 0x0B, 0x70, 0x01, 0x24};
  // byte Speed[] = {0xD5, 0x5D, 0xFE, 0x0A, 0x83, 0x20, 0x02, 0x0A, 0x88, 0x81, 0x0B, 0x88, 0x01, 0x54};
  byte Speed[] = {0xD5, 0x5D, 0xFE, 0x0A, 0x83, 0x20, 0x02, 0x0A, 0x99, 0x81, 0x0B, 0x99, 0x01, 0x76};



  sendBytes(Speed, sizeof(Speed));

  // byte A_Wheel[] = {0xD5, 0x5D, 0x0A, 0x04, 0x02, 0x28, 0x02, 0x3A};
  // // byte A_Wheel[] = {213, 93, 10, 4, 2, 40, 2, 58};
  // sendBytes(A_Wheel, sizeof(A_Wheel));

  // byte B_Wheel[] = {0xD5, 0x5D, 0x0B, 0x04, 0x02, 0x28, 0x02, 0x3B};  
  // // byte B_Wheel[] = {213, 93, 11, 4, 2, 40, 2, 59};
  // sendBytes(B_Wheel, sizeof(B_Wheel));

  // byte A_Reponse[] = {0xD5, 0x5D, 0x0A, 0x04, 0x10, 0xA6, 0x0A, 0xCE};
  // sendBytes(A_Reponse, sizeof(A_Reponse));
  
  // byte B_Reponse[] = {0xD5, 0x5D, 0x0B, 0x04, 0x10, 0xC8, 0x09, 0xF0};
  // sendBytes(B_Reponse, sizeof(B_Reponse));

  delay(100);

// D5 5D FE A 83 20 2 A 0 0 B 0 0 C2 
  
  
  // UART0에서 데이터 수신
  // 로봇 본체에서 데이터 수신
  // 모터로 통신을 전달
  while (Serial1.available()) {
    char data = Serial1.read();
    if (data == 0xD5) {
        Serial.println();  
        Serial.print("1번 RX : ");
        Serial.print(data, HEX);
        Serial.print(" ");
        Serial2.write(data);
        
    } else {
        Serial.print(data, HEX);
        Serial.print(" ");
        Serial2.write(data);
        
    }
  }

  // UART1에서 데이터 수신
  // 모터에서 데이터를 수신
  // 본체로 응답을 보냄
  while (Serial2.available()) {
    char data = Serial2.read();
    if (data == 0xD5) {
        Serial.println();
        Serial.print("3번 RX : ");
        Serial.print(data, HEX);
        Serial.print(" ");
        Serial1.print(data);
        
    } else {
        Serial.print(data, HEX);
        Serial.print(" ");
        Serial1.print(data);
    }
  }
}
